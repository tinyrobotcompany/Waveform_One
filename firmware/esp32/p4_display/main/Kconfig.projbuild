## firmware/esp32/p4_display/main/Kconfig.projbuild
```kconfig
menu "Waveform recognition audio"
    config WAVEFORM_CONTINUOUS_RECOGNITION
        bool "Run recognition independently of acoustic loudness"
        default n
        help
            Feed the normal rate-limited recognition schedule whenever audio
            arrives. Loudness votes do not start, stop or hide matches. Albums
            can remain visible after music stops; stop detection is separate.
    config WAVEFORM_P4_MIC
        bool "Use onboard P4 microphones instead of S3 USB audio"
        default n
    config WAVEFORM_P4_MIC_CHANNEL
        int "Onboard stereo input channel (0 or 1)"
        depends on WAVEFORM_P4_MIC
        range 0 1
        default 0
    config WAVEFORM_P4_MIC_GAIN_DB
        int "Onboard microphone gain in dB"
        depends on WAVEFORM_P4_MIC
        range 0 36
        default 24
endmenu

menu "Experimental P4 HUB75 takeover"
    config WAVEFORM_P4_LED
        bool "Drive HUB75 directly from the P4 expansion connectors"
        depends on WAVEFORM_P4_MIC
        default n
        help
            Requires the documented buffered adapter and rewiring. Disables
            the S3 USB controller path. Never enable on unverified wiring.
    config WAVEFORM_P4_LED_PATTERN
        bool "Show diagnostic stripes instead of audio"
        depends on WAVEFORM_P4_LED
        default y
endmenu
```

## firmware/esp32/p4_display/sdkconfig.defaults
```kconfig
# ESP32-P4-WIFI6-Touch-LCD-7B production-silicon profile.
# Rev 1.1 printed on the board is a PCB revision, not the ESP32-P4 silicon revision.
CONFIG_IDF_TARGET="esp32p4"
# CONFIG_ESP32P4_SELECTS_REV_LESS_V3 is not set
CONFIG_ESP32P4_REV_MIN_300=y
CONFIG_ESPTOOLPY_FLASHMODE_QIO=y
CONFIG_ESPTOOLPY_FLASHSIZE_32MB=y
CONFIG_BOOTLOADER_LOG_LEVEL_WARN=y
CONFIG_BOOTLOADER_LOG_LEVEL=2
CONFIG_PARTITION_TABLE_CUSTOM=y
CONFIG_COMPILER_OPTIMIZATION_PERF=y
CONFIG_SPIRAM=y
CONFIG_SPIRAM_SPEED_200M=y
CONFIG_SPIRAM_XIP_FROM_PSRAM=y
CONFIG_CACHE_L2_CACHE_256KB=y
CONFIG_CACHE_L2_CACHE_LINE_128B=y
CONFIG_ESP_MAIN_TASK_STACK_SIZE=10240
CONFIG_FREERTOS_HZ=1000
CONFIG_LV_USE_CLIB_MALLOC=y
CONFIG_LV_USE_CLIB_STRING=y
CONFIG_LV_USE_CLIB_SPRINTF=y
CONFIG_LV_DEF_REFR_PERIOD=15
CONFIG_LV_OS_FREERTOS=y
CONFIG_LV_DRAW_SW_DRAW_UNIT_CNT=2
# CONFIG_LV_ATTRIBUTE_FAST_MEM_USE_IRAM is not set
CONFIG_LV_FONT_MONTSERRAT_16=y
CONFIG_LV_FONT_MONTSERRAT_20=y
CONFIG_LV_FONT_MONTSERRAT_24=y
CONFIG_LV_FONT_MONTSERRAT_32=y
CONFIG_LV_FONT_MONTSERRAT_48=y
CONFIG_LV_USE_QRCODE=y
CONFIG_IDF_EXPERIMENTAL_FEATURES=y
CONFIG_SPI_FLASH_SUPPORT_GD_CHIP=y
```

## firmware/esp32/visualizer/sdkconfig.defaults
```kconfig
CONFIG_IDF_TARGET="esp32s3"
CONFIG_ESPTOOLPY_FLASHSIZE_16MB=y
CONFIG_FREERTOS_HZ=1000
CONFIG_ESP_CONSOLE_SECONDARY_USB_SERIAL_JTAG=y

CONFIG_PARTITION_TABLE_CUSTOM=y
CONFIG_PARTITION_TABLE_CUSTOM_FILENAME="partitions.csv"
CONFIG_BOOTLOADER_APP_ROLLBACK_ENABLE=y
```
